## build/Kconfig/Kconfig.shield.defconfig
```kconfig
osource "d:/onedrive/dokumente/haus/home_assistant/nrf52840_bmp280_ble_nordicsdk/bmp280_ble/boards/shields/*/Kconfig.defconfig"
osource "C:/ncs/v2.4.2/nrf/boards/shields/*/Kconfig.defconfig"
```
